## external/Config.in
```kconfig
source "$BR2_EXTERNAL_Greenbone_Tools_PATH/package/python-gvm/Config.in"
source "$BR2_EXTERNAL_Greenbone_Tools_PATH/package/gvm-tools/Config.in"
source "$BR2_EXTERNAL_Greenbone_Tools_PATH/package/ospd/Config.in"
source "$BR2_EXTERNAL_Greenbone_Tools_PATH/package/ospd-openvas/Config.in"
```

## external/configs/greenbone_defconfig
```kconfig
BR2_x86_64=y
BR2_USE_WCHAR=y
BR2_TOOLCHAIN_BUILDROOT_WCHAR=y
BR2_TOOLCHAIN_USES_GLIBC=y
BR2_PACKAGE_CMAKE=y
BR2_PACKAGE_GREENBONE_PYTHON_GVM=y
BR2_PACKAGE_GREENBONE_GVM_TOOLS=y
BR2_PACKAGE_GREENBONE_OSPD=y
BR2_PACKAGE_GREENBONE_OSPD_OPENVAS=y
BR2_PACKAGE_PYTHON3=y

BR2_PACKAGE_RSYNC=y

BR2_PACKAGE_REDIS=y
BR2_TOOLCHAIN_HAS_LIBATOMIC=y
BR2_PACKAGE_LIBOPENSSL=y

BR2_PACKAGE_NODEJS=y
BR2_PACKAGE_NODEJS_NPM=y
```

## external/package/gvm-tools/Config.in
```kconfig
config BR2_PACKAGE_GREENBONE_GVM_TOOLS
    bool "gvm-tools"
    depends on BR2_PACKAGE_PYTHON || BR2_PACKAGE_PYTHON3
    help
      gvm-tools package
```

## external/package/ospd-openvas/Config.in
```kconfig
config BR2_PACKAGE_GREENBONE_OSPD_OPENVAS
    bool "ospd-openvas"
    depends on BR2_PACKAGE_PYTHON || BR2_PACKAGE_PYTHON3
    help
      ospd-openvas package
```

## external/package/ospd/Config.in
```kconfig
config BR2_PACKAGE_GREENBONE_OSPD
    bool "ospd"
    depends on BR2_PACKAGE_PYTHON || BR2_PACKAGE_PYTHON3
    help
      ospd package
```

## external/package/python-gvm/Config.in
```kconfig
config BR2_PACKAGE_GREENBONE_PYTHON_GVM
    bool "python-gvm"
    depends on BR2_PACKAGE_PYTHON || BR2_PACKAGE_PYTHON3
    help
      python-gvm package
```
